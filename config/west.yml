## config/west.yml
```yaml
manifest:
  remotes:
    - name: zmkfirmware
      url-base: https://github.com/zmkfirmware
    # Additional modules containing boards/shields/custom code can be listed here as well
    # See https://docs.zephyrproject.org/3.2.0/develop/west/manifest.html#projects
    - name: nxtkb
      url-base: https://github.com/nxtkb
  projects:
    - name: zmk
      remote: nxtkb
      revision: b66b8b4e07655d16c01d14bfa06e2f7f6c46025f
      import: app/west.yml
    - name: zmk-feature-codex-micro
      remote: nxtkb
      revision: cb08948c527a206f02b9ca7a567bc2437ccd4970
    - name: zmk-behavior-report
      remote: nxtkb
      revision: 476f43da1f98b4a6150c9c0e499a257bd64a29a0
      import: west.yml
  self:
    path: config
```
